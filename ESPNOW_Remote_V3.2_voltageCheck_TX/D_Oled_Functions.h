U8G2_SH1106_128X64_NONAME_F_HW_I2C u8g2(U8G2_R0, /* reset=*/ U8X8_PIN_NONE);
//U8G2_SSD1306_128X64_NONAME_F_4W_SW_SPI u8g2(U8G2_R0, /* clock=*/ 22, /* data=*/ 23, /* cs=*/ U8X8_PIN_NONE, /* dc=*/ 21, /* reset=*/ 19);

const unsigned char polinesLogo [] PROGMEM = {
  0x00, 0x00, 0x00, 0x00, 0x00, 0x00, 0x00, 0x00, 0x00, 0x00, 0x00, 0x00, 0x00, 0x00, 0x00, 0x00, 
  0x00, 0x00, 0x00, 0x00, 0x00, 0x00, 0x00, 0x00, 0x00, 0x00, 0x00, 0x00, 0x00, 0x00, 0x00, 0x00, 
  0x00, 0x00, 0x00, 0x00, 0x00, 0x00, 0x00, 0x00, 0x00, 0x00, 0x00, 0x00, 0x00, 0x00, 0x00, 0x00, 
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  0x00, 0x00, 0x00, 0x00, 0x00, 0x00, 0x00, 0x00, 0x00, 0x00, 0x00, 0x00, 0x00, 0x00, 0x00, 0x00
};
static const unsigned char image_music_radio_broadcast_bits[] = {0xe0,0x03,0x18,0x0c,0xe4,0x13,0x12,0x24,0xc9,0x49,0x25,0x52,0x95,0x54,0xc5,0x51,0x60,0x03,0xc0,0x01,0x80,0x00,0xc0,0x01,0x40,0x01,0x60,0x03,0x20,0x02,0x00,0x00};
static const unsigned char image_Battery_bits[] = {0x00,0x00,0x00,0x00,0x80,0x01,0xc0,0x03,0x20,0x04,0x20,0x04,0xa0,0x05,0x20,0x04,0xa0,0x05,0x20,0x04,0xa0,0x05,0x20,0x04,0xc0,0x03,0x00,0x00,0x00,0x00,0x00,0x00};
static const unsigned char image_arrow_up_bits[] = {0x04,0x0e,0x15,0x04,0x04,0x04,0x04};
static const unsigned char image_arrow_down_bits[] = {0x04,0x04,0x04,0x04,0x15,0x0e,0x04};
static const unsigned char image_arrow_right_bits[] = {0x10,0x20,0x7f,0x20,0x10};
static const unsigned char image_arrow_left_bits[] = {0x04,0x02,0x7f,0x02,0x04};
static const unsigned char image_InfraredArrowUp_bits[] = {0x18,0x3c,0x7e,0xff};
static const unsigned char image_InfraredArrowDown_bits[] = {0xff,0x7e,0x3c,0x18};
static const unsigned char image_ButtonRight_bits[] = {0x01,0x03,0x07,0x0f,0x07,0x03,0x01};
static const unsigned char image_ButtonLeft_bits[] = {0x08,0x0c,0x0e,0x0f,0x0e,0x0c,0x08};

//==============================================oled Disp FUNC==============================================//
void OledDisplaySend(){
  unsigned long startTime = micros();
  
  u8g2.clearBuffer();
  u8g2.setFont(u8g2_font_t0_18b_tr);
  u8g2.drawStr(1, 12, connectOk ? "CONN OK" : "ERROR"); //status data
  u8g2.drawRFrame(-3, -3, 71, 18, 4);
  u8g2.drawStr(73, 12, "R1");                           // remote number
  u8g2.drawRFrame(70, -4, 23, 19, 4);
  u8g2.drawXBM(94, -1, 16, 16, image_Battery_bits);     //battery logo
  String voltStr = String(batteryPercentage, 1);  
  u8g2.setFont(u8g2_font_5x7_tr);
  u8g2.drawStr(107, 10, voltStr.c_str());                        //battery voltage
  u8g2.drawStr(123, 10, "V");   
  u8g2.drawRFrame(95, -4, 36, 19, 4);

  u8g2.setFont(u8g2_font_helvB08_tr);
  for(uint8_t i = 0; i < 15; i++){                 
    sendData.stat[i] = !digitalRead(button[i]);
    if(sendData.stat[i]){
      switch(i){
        case 0 : u8g2.drawStr(36, 28, "L3");                                break;
        case 1 : u8g2.drawStr(114, 28, "R3");                               break;
        case 2 : u8g2.drawStr(19, 28, "L2");                                break;
        case 3 : u8g2.drawStr(2, 28, "L1");                                 break;
        case 4 : u8g2.drawXBMP(19, 45, 5, 7, image_arrow_up_bits);          break;
        case 5 : u8g2.drawXBMP(13, 51, 7, 5, image_arrow_left_bits);        break;
        case 6 : u8g2.drawXBMP(19, 55, 5, 7, image_arrow_down_bits);        break;
        case 7 : u8g2.drawXBMP(23, 51, 7, 5, image_arrow_right_bits);       break;
        case 8 : u8g2.drawXBMP(98, 50, 4, 7, image_ButtonLeft_bits);        break;
        case 9 : u8g2.drawXBMP(103, 58, 8, 4, image_InfraredArrowDown_bits);break;
        case 10 : u8g2.drawXBMP(112, 50, 4, 7, image_ButtonRight_bits);     break;
        case 11 : u8g2.drawXBMP(103, 45, 8, 4, image_InfraredArrowUp_bits); break;
        case 12 : u8g2.drawStr(96, 28, "R2");                               break;
        case 13 : u8g2.drawStr(78, 28, "R1");                               break;
        default : break;
      }
    }
  }
  u8g2.drawRFrame(52, 17, 21, 14, 3);
  u8g2.setFont(u8g2_font_haxrcorp4089_tr);
  u8g2.drawStr(57, 28, sendData.stat[14] ? "OFF" : "ON");
  u8g2.drawRFrame(-3, 17, 54, 14, 3);
  u8g2.drawRFrame(74, 17, 58, 14, 3);
  u8g2.drawRFrame(11, 43, 21, 21, 4);       //box for r/l
  u8g2.drawRFrame(96, 42, 22, 22, 4);       //box for r/l
  u8g2.drawRFrame(32, 32, 32, 32, 5);       //box for joystick
  u8g2.drawRFrame(64, 32, 32, 32, 5);       //box for joystick
//  u8g2.drawFrame(joy1XBox - boxSize / 2, joy1YBox - boxSize / 2, boxSize, boxSize);
//  u8g2.drawFrame(joy2XBox - boxSize / 2, joy2YBox - boxSize / 2, boxSize, boxSize);
  u8g2.drawDisc(joy1XPos-1, joy1YPos, 3, U8G2_DRAW_ALL);
  u8g2.drawDisc(joy2XPos-1, joy2YPos, 3, U8G2_DRAW_ALL);
  
//  u8g2.updateDisplayArea(0, 2, 16, 6);
  u8g2.sendBuffer();
  
  unsigned long endTime = micros(); 
  unsigned long elapsedTime = endTime - startTime;
  Serial.print("Time to send data: ");
  Serial.print(elapsedTime);
  Serial.println(" microseconds");
}

void dispSplashLogo(){
  u8g2.setFontMode(1);
  u8g2.setBitmapMode(1);
  u8g2.setFont(u8g2_font_helvB08_tr);
  u8g2.drawStr(105, 8, "V3.1");
  u8g2.drawXBMP(0, 0, 128, 64, polinesLogo);
  u8g2.sendBuffer();
  delay(3000);
  for (int i = 0; i <= 100; i = i + 5) {
    u8g2.clearBuffer();
    u8g2.drawXBMP(0, 0, 128, 45, polinesLogo);
    u8g2.drawRFrame(10, 48, 108, 14, 3);
    u8g2.drawBox(12, 50, i, 10); 
    u8g2.updateDisplayArea(0, 6, 16, 2);  //tile_area_x_pos, tile_area_y_pos, tile_area_width, tile_area_height
  }
}

void displaySetPage(){
  u8g2.clearBuffer();
  u8g2.setFontMode(1);
  u8g2.setBitmapMode(1);
  u8g2.setFont(u8g2_font_t0_18b_tr);
  u8g2.drawStr(1, 12, "SETTING");
  u8g2.drawRFrame(-3, -3, 71, 18, 4);
  u8g2.drawStr(73, 12, "R1");
  u8g2.drawRFrame(70, -4, 23, 19, 4);
  u8g2.drawXBM(94, -1, 16, 16, image_Battery_bits);
  String voltStr = String(batteryPercentage, 1);  
  u8g2.setFont(u8g2_font_5x7_tr);
  u8g2.drawStr(107, 10, voltStr.c_str());                        //battery voltage
  u8g2.drawStr(123, 10, "%");   
  u8g2.drawRFrame(95, -4, 36, 19, 4);
  u8g2.drawRFrame(1, 17, 126, 14, 4);
  u8g2.setFont(u8g2_font_t0_11b_tr);
  u8g2.drawStr(5, 28, "SSID:ESPNOW.REMOTE_1");
  u8g2.drawRFrame(-3, 49, 45, 14, 4);
  u8g2.setFont(u8g2_font_t0_14b_tr);
  u8g2.drawStr(17, 61, "IP");
  u8g2.drawRFrame(-3, 33, 56, 15, 4);
  u8g2.setFont(u8g2_font_t0_13b_tr);
  u8g2.drawStr(1, 45, "PASSWRD");
  u8g2.drawRFrame(55, 33, 89, 15, 4);
  u8g2.drawStr(59, 45, "LEXARGA24");
  u8g2.setFont(u8g2_font_t0_17b_tr);
  u8g2.drawStr(31, 60, ":");
  u8g2.drawXBM(1, 51, 15, 16, image_music_radio_broadcast_bits);
  u8g2.drawRFrame(44, 49, 100, 14, 4);
  u8g2.setFont(u8g2_font_t0_13b_tr);
  u8g2.drawStr(47, 61, "192.168.4.1");
  u8g2.sendBuffer();
}
